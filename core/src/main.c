/* Includes ------------------------------------------------------------------*/
#include "main.h"
#include "dht11.h"
#include "ssm.h"
#include <stdio.h>
#include <string.h>
/* Private variables ---------------------------------------------------------*/
UART_HandleTypeDef huart2;
TIM_HandleTypeDef htim2;

/* Private function prototypes -----------------------------------------------*/
void SystemClock_Config(void);
static void MX_GPIO_Init(void);
static void MX_USART2_UART_Init(void);
static void MX_TIM2_Init(void);

/**
  * @brief  The application entry point.
  * @retval int
  */
int main(void)
{
  /* MCU Configuration--------------------------------------------------------*/
  HAL_Init();
  SystemClock_Config();

  /* Initialize all configured peripherals */
  MX_GPIO_Init();
  MX_TIM2_Init();
  MX_USART2_UART_Init();

  /* USER CODE BEGIN 2 */
  // --- Initialize Hardware and Edge AI Model ---

  // Start the microsecond timer for DHT11 timing
  HAL_TIM_Base_Start(&htim2);

  // Seed the State Space Model with an initial sensor reading
  DHT11_Data init_data = DHT11_Read();
  SSM_State ssm;

  // If sensor fails on first boot, default to 25.0 degrees
  SSM_Init(&ssm, init_data.valid ? init_data.temperature : 25.0f);

  uint32_t cycle = 0;
  char msg[128];

  /* USER CODE END 2 */

  /* Infinite loop */
  /* USER CODE BEGIN WHILE */
  while (1)
  {
    // 1. Edge AI Step: Predict the temperature before reading the sensor
    float predicted = SSM_Predict(&ssm);

    // 2. Data Acquisition: Read real-time values from DHT11
    DHT11_Data d = DHT11_Read();

    if (d.valid)
    {
        // 3. Edge Processing: Update model state and calculate Accuracy Score
        float error, accuracy, rolling_mae;
        SSM_Update(&ssm, d.temperature, &error, &accuracy, &rolling_mae);

        // 4. Data Visualization: Transmit CSV data to PC via UART2
//        // Format: cycle, actual, humidity, predicted, error, accuracy, mae
//        snprintf(msg, sizeof(msg), "%lu,%.2f,%.2f,%.2f,%.2f,%.1f,%.3f\r\n",
//                 (unsigned long)cycle++,
//                 d.temperature,
//                 d.humidity,
//                 predicted,
//                 error,
//                 accuracy,
//                 rolling_mae);
        snprintf(msg, sizeof(msg),
                 "Cycle:%lu | Temp:%.2f | Hum:%.2f | Pred:%.2f | Err:%.2f | Acc:%.1f%% | MAE:%.3f\r\n",
                 (unsigned long)cycle++,
                 d.temperature,
                 d.humidity,
                 predicted,
                 error,
                 accuracy,
                 rolling_mae);

        HAL_UART_Transmit(&huart2, (uint8_t*)msg, strlen(msg), 100);
    }
    else
    {
        // Optional: Notify if sensor read failed
        const char *err_msg = "# DHT11 Read Failed\r\n";
        HAL_UART_Transmit(&huart2, (uint8_t*)err_msg, strlen(err_msg), 100);
    }

    // DHT11 requires at least 1-2 seconds between readings for stability
    HAL_Delay(2000);

    /* USER CODE END WHILE */

    /* USER CODE BEGIN 3 */
  }
  /* USER CODE END 3 */
}

/**
  * @brief System Clock Configuration (84MHz for F446)
  */
void SystemClock_Config(void)
{
  RCC_OscInitTypeDef RCC_OscInitStruct = {0};
  RCC_ClkInitTypeDef RCC_ClkInitStruct = {0};

  __HAL_RCC_PWR_CLK_ENABLE();
  __HAL_PWR_VOLTAGESCALING_CONFIG(PWR_REGULATOR_VOLTAGE_SCALE1);

  RCC_OscInitStruct.OscillatorType = RCC_OSCILLATORTYPE_HSI;
  RCC_OscInitStruct.HSIState = RCC_HSI_ON;
  RCC_OscInitStruct.HSICalibrationValue = RCC_HSICALIBRATION_DEFAULT;
  RCC_OscInitStruct.PLL.PLLState = RCC_PLL_ON;
  RCC_OscInitStruct.PLL.PLLSource = RCC_PLLSOURCE_HSI;
  RCC_OscInitStruct.PLL.PLLM = 16;
  RCC_OscInitStruct.PLL.PLLN = 336;
  RCC_OscInitStruct.PLL.PLLP = RCC_PLLP_DIV4;
  RCC_OscInitStruct.PLL.PLLQ = 2;
  RCC_OscInitStruct.PLL.PLLR = 2;
  HAL_RCC_OscConfig(&RCC_OscInitStruct);

  RCC_ClkInitStruct.ClockType = RCC_CLOCKTYPE_HCLK|RCC_CLOCKTYPE_SYSCLK
                              |RCC_CLOCKTYPE_PCLK1|RCC_CLOCKTYPE_PCLK2;
  RCC_ClkInitStruct.SYSCLKSource = RCC_SYSCLKSOURCE_PLLCLK;
  RCC_ClkInitStruct.AHBCLKDivider = RCC_SYSCLK_DIV1;
  RCC_ClkInitStruct.APB1CLKDivider = RCC_HCLK_DIV2;
  RCC_ClkInitStruct.APB2CLKDivider = RCC_HCLK_DIV1;
  HAL_RCC_ClockConfig(&RCC_ClkInitStruct, FLASH_LATENCY_2);
}

/* Peripheral Initialization Functions (Generated by CubeMX) */
static void MX_TIM2_Init(void)
{
  htim2.Instance = TIM2;
  htim2.Init.Prescaler = 83; // Gives 1us per tick at 84MHz
  htim2.Init.CounterMode = TIM_COUNTERMODE_UP;
  htim2.Init.Period = 65535;
  htim2.Init.ClockDivision = TIM_CLOCKDIVISION_DIV1;
  htim2.Init.AutoReloadPreload = TIM_AUTORELOAD_PRELOAD_ENABLE;
  HAL_TIM_Base_Init(&htim2);
}

static void MX_USART2_UART_Init(void)
{
  huart2.Instance = USART2;
  huart2.Init.BaudRate = 115200;
  huart2.Init.WordLength = UART_WORDLENGTH_8B;
  huart2.Init.StopBits = UART_STOPBITS_1;
  huart2.Init.Parity = UART_PARITY_NONE;
  huart2.Init.Mode = UART_MODE_TX_RX;
  huart2.Init.HwFlowCtl = UART_HWCONTROL_NONE;
  huart2.Init.OverSampling = UART_OVERSAMPLING_16;
  HAL_UART_Init(&huart2);
}

static void MX_GPIO_Init(void)
{
  __HAL_RCC_GPIOA_CLK_ENABLE();
  GPIO_InitTypeDef GPIO_InitStruct = {0};

  // Configure PA1 for DHT11
  GPIO_InitStruct.Pin = GPIO_PIN_1;
  GPIO_InitStruct.Mode = GPIO_MODE_OUTPUT_PP;
  GPIO_InitStruct.Pull = GPIO_NOPULL;
  GPIO_InitStruct.Speed = GPIO_SPEED_FREQ_LOW;
  HAL_GPIO_Init(GPIOA, &GPIO_InitStruct);

  HAL_GPIO_WritePin(GPIOA, GPIO_PIN_1, GPIO_PIN_SET);
}

void Error_Handler(void)
{
  __disable_irq();
  while (1) {}
}
